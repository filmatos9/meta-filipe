## conf/layer.conf
```bitbake
# We have a conf and classes directory, add to BBPATH
BBPATH .= ":${LAYERDIR}"

# We have recipes-* directories, add to BBFILES
BBFILES += "${LAYERDIR}/recipes-*/*/*.bb \
            ${LAYERDIR}/recipes-*/*/*.bbappend"

BBFILE_COLLECTIONS += "meta-filipe"
BBFILE_PATTERN_meta-filipe = "^${LAYERDIR}/"
BBFILE_PRIORITY_meta-filipe = "6"

LAYERDEPENDS_meta-filipe = "core"
LAYERSERIES_COMPAT_meta-filipe = "kirkstone"
```
